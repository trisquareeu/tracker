## CMakeLists.txt
```
cmake_minimum_required(VERSION 3.20.0)
find_package(Zephyr REQUIRED HINTS $ENV{ZEPHYR_BASE})

project(tracker)
set(CMAKE_CXX_STANDARD 20)
target_compile_options(app PRIVATE -Wall -Wextra -Wno-unused-parameter -Wno-unused-function -Wno-ignored-qualifiers)

target_sources(app PRIVATE src/main.cpp)
```

## prj.conf
```kconfig
CONFIG_CPP=y
CONFIG_STD_CPP20=y
CONFIG_GLIBCXX_LIBCPP=y
CONFIG_REQUIRES_FULL_LIBCPP=y

CONFIG_FPU=y
```

## src/main.cpp
```c
#include <zephyr/kernel.h>

#include <vector>

int main(void) {
  std::vector<int> v;

  while (true) {
    v.push_back(1);
    k_sleep(K_MSEC(1000));

    printk("Vector size: %d\n", v.size());

    v.pop_back();
  }
}
```
